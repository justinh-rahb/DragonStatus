## components/ds_board/Kconfig
```kconfig
menu "DragonStatus hardware"

config DS_BOARD_STATUS_PRODUCTION
    bool "BTT Status-family production RGB output"
    default n
    help
        Select this only for the Panda Status/Panda Lux RGB PX/PopStatus board.
        The OEM RGB initializer configures an RMT TX channel on GPIO4 and
        drives a WS2812 strip. Panda Status has 25 LEDs while PopStatus has
        27; DragonStatus emits 27 positions, which is safe on the shorter
        one-way Panda chain because it discards the last two records. The
        normal development-C3 build instead uses its on-board WS2812 on GPIO8.

endmenu
```
